## components/tiercel_board/Kconfig
```kconfig
menu "Tiercel board"

    config TIERCEL_KNOB_INVERT
        bool "Invert knob direction"
        default n
        help
            Swap clockwise and anticlockwise. The knob's A contact is wired as
            clockwise on the Waveshare 1.8" module; set this only if a unit
            turns the wrong way.

    config TIERCEL_HAPTIC_LRA
        bool "Drive the haptic motor as an LRA"
        default n
        help
            The schematic labels the motor nets LRA_P/LRA_N, but Waveshare's
            demo drives the DRV2605 in ERM open-loop mode and that works on
            the units tested. Enable this (and set the library to 6, the LRA
            library) if a unit feels weak.

    config TIERCEL_HAPTIC_LIBRARY
        int "DRV2605 waveform library"
        range 1 7
        default 5
        help
            1-5 are ERM libraries, 6 is LRA, 7 is the 4.5V ERM library. 5 is
            what Waveshare's demo selects.

    config TIERCEL_HAPTIC_LIMIT_EFFECT
        int "Effect for a knob value at its limit"
        range 1 123
        default 1
        help
            Played on every extra detent once a knob-adjusted value is at its
            minimum or maximum. 1 is "Strong Click 100%" in the DRV2605 ROM
            library table.

    config TIERCEL_HAPTIC_TAP_EFFECT
        int "Effect for an accepted tap"
        range 1 123
        default 24
        help
            24 is "Sharp Tick 1 100%".

    config TIERCEL_HAPTIC_CONFIRM_EFFECT
        int "Effect for a committed change"
        range 1 123
        default 10
        help
            10 is "Double Click 100%". Played when something takes effect --
            a device toggles, a mode is set.

    config TIERCEL_HAPTIC_ALERT_EFFECT
        int "Effect for an alarm"
        range 1 123
        default 47
        help
            47 is "Buzz 1 100%".

endmenu
```

## main/Kconfig.projbuild
```kconfig
menu "Tiercel"

comment "Behaviour"

config TIERCEL_IDLE_TIMEOUT_S
    int "Seconds of inactivity before the idle clock appears"
    range 0 3600
    default 30
    help
      Initial value only; the user changes it under Settings > Clock Timeout
      and it is stored in NVS. 0 never returns to the clock.

config TIERCEL_ALARM_SNOOZE_MIN
    int "Minutes an acknowledged alarm stays quiet"
    range 1 240
    default 10
    help
      Initial value only. A tap on the alert overlay acknowledges every alarm
      on it; one still active after this long is raised again. Changed on the
      device under Settings > Alarm Snooze.

config TIERCEL_DEFAULT_UNITS_CELSIUS
    bool "Default to Celsius"
    default n

config TIERCEL_DEFAULT_THEME_DARK
    bool "Default to the dark theme"
    default y
    help
      The design's default. Changed on the device under Settings > Theme.

comment "Connectivity"

config TIERCEL_MQTT_DEFAULT_PORT
    int "Default MQTT port"
    default 8883
    help
      Headwaters' Mosquitto listens only on 8883, TLS, with a username and
      password. This is what the setup portal starts from.

config TIERCEL_WIFI_TX_POWER_QDBM
    int "Wi-Fi maximum transmit power (quarter-dBm)"
    range 8 80
    default 80
    help
      esp_wifi_set_max_tx_power() takes quarter-dBm: 80 is 20 dBm, the
      driver's default. Lower it only for a unit whose setup AP cannot be
      seen while it can itself see networks -- the signature of a 3V3 rail
      that sags on transmit bursts (Capstan's MaTouch needed 44).

endmenu
```
